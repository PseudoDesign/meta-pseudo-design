## conf/layer.conf
```bitbake
# We have a conf and classes directory, add to BBPATH
BBPATH .= ":${LAYERDIR}"

# We have recipes-* directories, add to BBFILES
BBFILES += "${LAYERDIR}/recipes-*/*/*.bb \
	${LAYERDIR}/recipes-*/*/*.bbappend"

LAYERSERIES_COMPAT_pseudo-design = "gatesgarth"

BBFILE_COLLECTIONS += "pseudo-design"
BBFILE_PATTERN_pseudo-design = "^${LAYERDIR}/"
BBFILE_PRIORITY_pseudo-design = "85"
```

## conf/machine/hello-world-zcu102-zynqmp.conf
```bitbake
#@TYPE: Machine
#@NAME: hello-world-zcu102-zynqmp
#@DESCRIPTION: Machine to support a hello world PL layer on ZCU102 hardware


require conf/machine/zcu102-zynqmp.conf

# Add pseudodesign linux SD image
# TODO: consider moving this to the distro configuration
IMAGE_CLASSES += " image-types-pseudo-design"
IMAGE_FSTYPES += " wic.pseudo-design-sd"
WKS_FILES = "pseudo-design-linux-sdcard.wks"

# Add pseudodesign linux specific recipes
# TODO: consider moving this to the distro configuration
IMAGE_INSTALL_append += " pd-data-partition"

# This machine has a QEMU model, runqemu setup:
QB_MEM = "-m 4096"
QB_OPT_APPEND ?= "-nographic -serial mon:stdio -serial null"
QB_NETWORK_DEVICE = "-net nic -net nic -net nic -net nic,netdev=net0,macaddr=@MAC@"

# Replicate BootROM like behaviour, having loaded SPL and PMU(ROM+FW)
QB_OPT_APPEND_append_qemuboot-xilinx = " \
		-hw-dtb ${DEPLOY_DIR_IMAGE}/qemu-hw-devicetrees/multiarch/zcu102-arm.dtb \
		${@qemu_zynqmp_unhalt(d, True)} \
		-device loader,file=${DEPLOY_DIR_IMAGE}/arm-trusted-firmware.elf,cpu-num=0 \
		-device loader,file=${DEPLOY_DIR_IMAGE}/u-boot.elf \
		-device loader,file=${DEPLOY_DIR_IMAGE}/system.dtb,addr=0x100000 \
		"

# Attach the rootfs disk image to the second SD interface of QEMU (which is SD0)
QB_DEFAULT_FSTYPE_qemuboot-xilinx = "wic.pseudo-design-sd"
QB_OPT_APPEND_append_qemuboot-xilinx = " -boot mode=5"
QB_ROOTFS_OPT_qemuboot-xilinx = " -drive if=sd,index=1,file=@ROOTFS@,format=raw"

QB_PMU_OPT = " \
		-M microblaze-fdt \
		-display none \
		-hw-dtb ${DEPLOY_DIR_IMAGE}/qemu-hw-devicetrees/multiarch/zynqmp-pmu.dtb \
		-kernel ${PMU_ROM} \
		-device loader,file=${PMU_FIRMWARE_DEPLOY_DIR}/${PMU_FIRMWARE_IMAGE_NAME}.elf \
		-device loader,addr=0xfd1a0074,data=0x1011003,data-len=4 \
		-device loader,addr=0xfd1a007C,data=0x1010f03,data-len=4 \
		"
# QB_OPT_APPEND_append_qemuboot-xilinx = " -pmu-args '${QB_PMU_OPT}'"

do_write_qemuboot_conf[depends] += "u-boot-zynq-uenv:do_deploy"
```

## meta-pd-core/wic/pseudo-design-linux-sdcard.wks
```
# short-description: Create SD card image formatted for pseudo-design-linux
# long-description: Creates a partitioned SD card image. Boot files
# are located in the first vfat partition.  Then two copies of the ROOTFS are created in
# ext4 partitions.  Then a data partition is created.

part /boot --source bootimg-partition --ondisk mmcblk0 --fstype=vfat --label boot --active --align 4 --size 64M
part / --source rootfs --ondisk mmcblk0 --fstype=ext4 --label rootfs-0 --align 4 --size 1G
part / --source rootfs --ondisk mmcblk0 --fstype=ext4 --label rootfs-1 --align 4 --size 1G --fsoptions "ro,suid,dev,noauto,nouser,async"
part /mnt/data --ondisk mmcblk0 --fstype=ext4 --label rootfs-1 --align 4 --size 1216M  
```
